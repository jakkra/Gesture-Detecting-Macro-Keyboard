## main/Kconfig.projbuild
```kconfig
menu "Gesture Detector Macro Keyboard"
    config RMT_TX_GPIO
        int "RMT TX GPIO"
        default 21
        help
            Set the GPIO number used for transmitting the RMT signal.
    config STRIP_LED_NUMBER
        int "Number of LEDS in a strip"
        default 5
        help
            Number of leds in your strip
    config ESP_WIFI_SSID
        string "WiFi SSID"
        default "myssid"
        help
            SSID (WiFi name) to connect to.
    config ESP_WIFI_PASSWORD
        string "WiFi Password"
        default "mypassword"
        help
            WiFi password to use.
    config I2C_SDA_PIN
        int "I2C SDA PIN"
        default 4
        help
            I2C SDA pin OLED and Trill sensors connected to.
    config I2C_SCL_PIN
        int "I2C SCL PIN"
        default 15
        help
            I2C SCL pin OLED and Trill sensors connected to.
    config OLED_RST_PIN
        int "OLED RESET PIN"
        default 16
        help
            Pin connected to OLED reset pin.
    config KEYBOARD_V2
        bool "New version with more keys and larger OLED display."
        default true
        help
            Use new version two of macro keyboard.
endmenu
```

## sdkconfig.defaults
```kconfig
CONFIG_RMT_TX_GPIO=21
CONFIG_STRIP_LED_NUMBER=5
CONFIG_ESP_WIFI_SSID="your_ssid"
CONFIG_ESP_WIFI_PASSWORD="your_password"

CONFIG_MAIN_TASK_STACK_SIZE=4096

CONFIG_BT_ENABLED=y
CONFIG_ESP32_WIFI_SW_COEXIST_ENABLE=y

CONFIG_PARTITION_TABLE_CUSTOM=y
CONFIG_PARTITION_TABLE_CUSTOM_FILENAME="partitions.csv"
CONFIG_PARTITION_TABLE_FILENAME="partitions.csv"

CONFIG_SPI_FLASH_USE_LEGACY_IMPL=y # Only needed for 2MB NINA-W10 modules, otherwise can be removed
```
